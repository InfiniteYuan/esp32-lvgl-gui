## components/lvgl_gui/Kconfig
```kconfig
menu "HMI components"

    choice GUI_LIV_SELECT
        bool "GUI Library Select"
        default LVGL_GUI_ENABLE
        
        config UGFX_GUI_ENABLE
            bool "uGFX GUI enable"
        
        config LVGL_GUI_ENABLE
            bool "LVGL GUI enable"

    endchoice

    menu "uGFX settings"
        depends on UGFX_GUI_ENABLE

        config UGFX_PROJ_RESOURCE_PATH
        string "UGFX RESOURCE FILE PATH UNDER PROJECT"
        default resource/include
        help
            Select UGFX resource file path under project, default is $(PROJECT_PATH)/source/include
            Usually the UGFX system would need some extra header file for custom resources
        
            
        config UGFX_USE_CUSTOM_DRIVER
            bool "UGFX USE CUSTOM DRIVER DEFINED BY USERS"
            default y
            help 
                Select to use your own LCD driver. Instead, the driver in ugfx_driver will be used.
                Sometimes the driver need to be modified or re-written, users can choose this option and 
                define their own driver in an independent component. 
            
        config UGFX_CUSTOM_DRIVER_KEEP_OPTIONS
            bool "UGFX CUSTOM DRIVER KEEP THE SAME OPTIONS"
            depends on UGFX_USE_CUSTOM_DRIVER
            default y
            help
                Sometimes the driver need to be modified or re-written, users can choose this option and 
                define their own driver in an independent component. 
                Select this to enable the same options as the default driver
            
        config UGFX_USE_CONFIGURED_OPTIONS
            bool
            default y if !UGFX_USE_CUSTOM_DRIVER
            default y if UGFX_CUSTOM_DRIVER_KEEP_OPTIONS
            default n
        
        menu "Config Custom Driver"
            depends on UGFX_USE_CUSTOM_DRIVER

            config UGFX_CUSTOM_DRIVER_COMPONENT_NAME
                string "UGFX CUSTOM DRIVER COMPONENT NAME"
                depends on UGFX_USE_CUSTOM_DRIVER
                default "gdrivers"
                help
                    Sometimes the driver need to be modified or re-written, users can choose this option and 
                    define their own driver in an independent component. 
                    Set this path to the cumtom board driver under project path, 
                    default path is $(PROJECT_PATH)/gdrivers
            
            choice UGFX_DRIVER_SCREEN
                depends on UGFX_USE_CUSTOM_DRIVER
                prompt "Choose Screen Driver"
                default UGFX_DRIVER_ST7789
                help
                    CHOOSE SCREEN DRIVER.
                
                config UGFX_DRIVER_ILI9341
                    bool "ILI9341"
                config UGFX_DRIVER_SSD1306
                    bool "SSD1306"
                config UGFX_DRIVER_ST7789
                    bool "ST7789"
                config UGFX_DRIVER_NT35510
                    bool "NT35510"
                config UGFX_DRIVER_EPAPER
                    bool "EPAPER"

            endchoice

            menu "ST7789 Screen Pin Configuration"
                depends on UGFX_USE_CONFIGURED_OPTIONS
                depends on UGFX_DRIVER_ST7789

                config UGFX_LCD_MISO_GPIO
                    int "UT_LCD_MISO_GPIO"
                    default "27"
                config UGFX_LCD_MOSI_GPIO
                    int "UT_LCD_MOSI_GPIO"
                    default "21"
                config UGFX_LCD_CLK_GPIO
                    int "UT_LCD_CLK_GPIO"
                    default "22"
                config UGFX_LCD_CS_GPIO
                    int "UT_LCD_CS_GPIO"
                    default "5"
                config UGFX_LCD_DC_GPIO
                    int "UT_LCD_DC_GPIO"
                    default "19"
                config UGFX_LCD_RESET_GPIO
                    int "UT_LCD_RESET_GPIO"
                    default "18"
                config UGFX_LCD_BL_GPIO
                    int "UT_LCD_BL_GPIO"
                    default "23"
            endmenu

            menu "ILI9341 Screen Pin Configuration"
                depends on UGFX_USE_CONFIGURED_OPTIONS
                depends on UGFX_DRIVER_ILI9341

                config UGFX_LCD_MISO_GPIO
                    int "UT_LCD_MISO_GPIO"
                    default "27"
                config UGFX_LCD_MOSI_GPIO
                    int "UT_LCD_MOSI_GPIO"
                    default "21"
                config UGFX_LCD_CLK_GPIO
                    int "UT_LCD_CLK_GPIO"
                    default "22"
                config UGFX_LCD_CS_GPIO
                    int "UT_LCD_CS_GPIO"
                    default "5"
                config UGFX_LCD_DC_GPIO
                    int "UT_LCD_DC_GPIO"
                    default "19"
                config UGFX_LCD_RESET_GPIO
                    int "UT_LCD_RESET_GPIO"
                    default "18"
                config UGFX_LCD_BL_GPIO
                    int "UT_LCD_BL_GPIO"
                    default "23"
            endmenu
            
            menu "SSD1306 Screen Pin Configuration"
                depends on UGFX_USE_CONFIGURED_OPTIONS
                depends on UGFX_DRIVER_SSD1306

                config UGFX_LCD_SCL_GPIO
                    int "UGFX_LCD_SCL_GPIO"
                    default "4"
                config UGFX_LCD_SDA_GPIO
                    int "UGFX_LCD_SDA_GPIO"
                    default "17"
                    
            endmenu

        endmenu          

        choice UGFX_DRIVER_MODE
            depends on UGFX_USE_CONFIGURED_OPTIONS
            bool "Display Driver Mode"
            default UGFX_LCD_DRIVER_FRAMEBUFFER_MODE

            config UGFX_LCD_DRIVER_FRAMEBUFFER_MODE
                bool "Select uGFX driver framebuffer mode"
            config UGFX_LCD_DRIVER_API_MODE
                bool "Select uGFX driver API mode" 

        endchoice
        
        config UGFX_DRIVER_AUTO_FLUSH_ENABLE
            depends on UGFX_LCD_DRIVER_FRAMEBUFFER_MODE
            bool "uGFX Driver Auto Flush Enable"
            default y
            help 
                "Select to enable uGFX screen auto flush for bufferframe mode"
                
        config UGFX_DRIVER_AUTO_FLUSH_INTERVAL
            depends on UGFX_DRIVER_AUTO_FLUSH_ENABLE
            int "uGFX Driver Auto Flush Interval(ms)"
            range 0 500
            default 50
            help 
                "Select to set the minimum screen flush interval for bufferframe mode"
                                 
        config UGFX_DRIVER_TOUCH_SCREEN_ENABLE
            depends on UGFX_USE_CONFIGURED_OPTIONS
            bool "uGFX Touch Screen Enable"
            default y
            help 
                "Select to enable uGFX touch screen"

            choice UGFX_DRIVER_TOUCH_SCREEN
                bool "Choose Touch Screen Driver"
                depends on UGFX_DRIVER_TOUCH_SCREEN_ENABLE
                
                config UGFX_DRIVER_TOUCH_XPT2046
                    bool "XPT2046"

                config UGFX_DRIVER_TOUCH_APDS9843
                    bool "APDS9843"

                config UGFX_DRIVER_TOUCH_FT5X06
                    bool "FT5X06"
                
            endchoice
        
            menu "XPT2046 Touch Screen Pin Configuration"
                depends on UGFX_USE_CONFIGURED_OPTIONS
                depends on UGFX_DRIVER_TOUCH_SCREEN_ENABLE
                depends on UGFX_DRIVER_TOUCH_XPT2046

                config UGFX_TOUCH_CS_GPIO
                    int "UGFX_TOUCH_CS_GPIO"
                    default "32"
                config UGFX_TOUCH_IRQ_GPIO
                    int "UGFX_TOUCH_IRQ_GPIO"
                    default "33"

            endmenu

            menu "uGFX Driver Screen Pin Configuration"
                depends on UGFX_USE_CONFIGURED_OPTIONS
                depends on !UGFX_USE_CUSTOM_DRIVER

                config UGFX_LCD_MISO_GPIO
                    int "UT_LCD_MISO_GPIO"
                    default "27"
                config UGFX_LCD_MOSI_GPIO
                    int "UT_LCD_MOSI_GPIO"
                    default "21"
                config UGFX_LCD_CLK_GPIO
                    int "UT_LCD_CLK_GPIO"
                    default "22"
                config UGFX_LCD_CS_GPIO
                    int "UT_LCD_CS_GPIO"
                    default "5"
                config UGFX_LCD_DC_GPIO
                    int "UT_LCD_DC_GPIO"
                    default "19"
                config UGFX_LCD_RESET_GPIO
                    int "UT_LCD_RESET_GPIO"
                    default "18"
                config UGFX_LCD_BL_GPIO
                    int "UT_LCD_BL_GPIO"
                    default "23"
            endmenu

        config UGFX_DRIVER_SCREEN_WIDTH
            depends on UGFX_USE_CONFIGURED_OPTIONS
            int "uGFX Screen Width (pixels)"
            range 0 5000
            default 240
            help
                "uGFX Screen Width (pixels)"
           
        config UGFX_DRIVER_SCREEN_HEIGHT
            depends on UGFX_USE_CONFIGURED_OPTIONS
            int "uGFX Screen Height (pixels)"
            range 0 5000
            default 320
            help
                "uGFX Screen Height (pixels)"

        config UGFX_DISP_ROTATE
            depends on UGFX_USE_CONFIGURED_OPTIONS
            int "Choose Screen Rotate"
            range 0 3
            default 1
            help
                "Choose Screen Rotate"

    endmenu

    menu "LVGL settings"
        depends on LVGL_GUI_ENABLE

        config LVGL_USE_CUSTOM_DRIVER
            bool "LVGL USE CUSTOM DRIVER DEFINED BY USERS"
            default y
            help 
                Select to use your own LCD driver. Instead, the driver in lvgl will be used.
                Sometimes the driver need to be modified or re-written, users can choose this option and 
                define their own driver in an independent component. 

        menu "Config Custom Driver"
            depends on LVGL_USE_CUSTOM_DRIVER

            config LVGL_CUSTOM_DRIVER_COMPONENT_NAME
                string "LVGL CUSTOM DRIVER COMPONENT NAME"
                depends on LVGL_USE_CUSTOM_DRIVER
                default "gdrivers"
                help
                    Sometimes the driver need to be modified or re-written, users can choose this option and 
                    define their own driver in an independent component. 
                    Set this path to the cumtom board driver under project path, 
                    default path is $(PROJECT_PATH)/LVGL_custom_driver
            
            choice LVGL_DRIVER_SCREEN
                depends on LVGL_USE_CUSTOM_DRIVER
                bool "Choose Screen Driver"
                default LVGL_DRIVER_ST7789
                help
                    Choose Screen Driver.
                
                config LVGL_DRIVER_ILI9341
                    bool "ILI9341"
                config LVGL_DRIVER_SSD1306
                    bool "SSD1306"
                config LVGL_DRIVER_ST7789
                    bool "ST7789"
                config LVGL_DRIVER_NT35510
                    bool "NT35510"

            endchoice

            menu "SSD1306 Screen Pin Configuration"
                depends on LVGL_DRIVER_SSD1306

                config LVGL_LCD_SCL_GPIO
                    int "LVGL_LCD_SCL_GPIO"
                    default "4"
                config LVGL_LCD_SDA_GPIO
                    int "LVGL_LCD_SDA_GPIO"
                    default "17"
            endmenu

            menu "ST7789 Pin Configuration"
                depends on LVGL_DRIVER_ST7789
                config LVGL_LCD_MISO_GPIO
                    int "UT_LCD_MISO_GPIO"
                    default "27"
                config LVGL_LCD_MOSI_GPIO
                    int "UT_LCD_MOSI_GPIO"
                    default "21"
                config LVGL_LCD_CLK_GPIO
                    int "UT_LCD_CLK_GPIO"
                    default "22"
                config LVGL_LCD_CS_GPIO
                    int "UT_LCD_CS_GPIO"
                    default "5"
                config LVGL_LCD_DC_GPIO
                    int "UT_LCD_DC_GPIO"
                    default "19"
                config LVGL_LCD_RESET_GPIO
                    int "UT_LCD_RESET_GPIO"
                    default "18"
                config LVGL_LCD_BL_GPIO
                    int "UT_LCD_BL_GPIO"
                    default "23"
            endmenu

            menu "ILI9341 Pin Configuration"
                depends on LVGL_DRIVER_ILI9341
                config LVGL_LCD_MISO_GPIO
                    int "UT_LCD_MISO_GPIO"
                    default "27"
                config LVGL_LCD_MOSI_GPIO
                    int "UT_LCD_MOSI_GPIO"
                    default "21"
                config LVGL_LCD_CLK_GPIO
                    int "UT_LCD_CLK_GPIO"
                    default "22"
                config LVGL_LCD_CS_GPIO
                    int "UT_LCD_CS_GPIO"
                    default "5"
                config LVGL_LCD_DC_GPIO
                    int "UT_LCD_DC_GPIO"
                    default "19"
                config LVGL_LCD_RESET_GPIO
                    int "UT_LCD_RESET_GPIO"
                    default "18"
                config LVGL_LCD_BL_GPIO
                    int "UT_LCD_BL_GPIO"
                    default "23"
            endmenu

        endmenu
                                    
        config LVGL_DRIVER_TOUCH_SCREEN_ENABLE
            bool "LVGL TOUCH-SCREEN ENABLE"
            default y
            help 
                "Select to enable LVGL touch screen function(xpt2046)

            choice LVGL_DRIVER_TOUCH_SCREEN
                bool "Choose Touch Screen Driver"
                depends on LVGL_DRIVER_TOUCH_SCREEN_ENABLE
                
                config LVGL_DRIVER_TOUCH_XPT2046
                    bool "XPT2046"

                config LVGL_DRIVER_TOUCH_APDS9843
                    bool "APDS9843"

                config LVGL_DRIVER_TOUCH_FT5X06
                    bool "FT5X06"
                
            endchoice
                        
        menu "XPT2046 Touch Pin Configuration"
            depends on LVGL_DRIVER_TOUCH_SCREEN_ENABLE
            depends on LVGL_DRIVER_TOUCH_XPT2046

            config LVGL_TOUCH_CS_GPIO
                int "LVGL_TOUCH_CS_GPIO"
                default "32"
            config LVGL_TOUCH_IRQ_GPIO
                int "LVGL_TOUCH_IRQ_GPIO"
                default "33"
        endmenu
                        
        menu "FT5X06 Touch Pin Configuration"
            depends on LVGL_DRIVER_TOUCH_SCREEN_ENABLE
            depends on LVGL_DRIVER_TOUCH_FT5X06

            config LVGL_TOUCH_IIC_NUM
                int "LVGL_TOUCH_IIC_NUM"
                default "0"
            config LVGL_TOUCH_IIC_SDA_GPIO
                int "LVGL_TOUCH_SDA_GPIO"
                default "1"
            config LVGL_TOUCH_IIC_SCL_GPIO
                int "LVGL_TOUCH_SCL_GPIO"
                default "3"
        endmenu

        config LVGL_DRIVER_SCREEN_WIDTH
            int "LVGL Screen Width (pixels)"
            range 0 5000
            default 240
            help
                "LVGL Screen Width (pixels)"
           
        config LVGL_DRIVER_SCREEN_HEIGHT
            int "LVGL Screen Height (pixels)"
            range 0 5000
            default 320
            help
                "LVGL Screen Height (pixels)"

        config LVGL_DISP_ROTATE
            depends on LVGL_USE_CUSTOM_DRIVER
            int "Choose Screen Rotate"
            range 0 3
            default 0
            help
                "Choose Screen Rotate"

    endmenu

endmenu
```
